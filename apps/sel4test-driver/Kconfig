## apps/sel4test-driver/Kconfig
```kconfig
#
# Copyright 2014, NICTA
#
# This software may be distributed and modified according to the terms of
# the BSD 2-Clause license. Note that NO WARRANTY is provided.
# See "LICENSE_BSD2.txt" for details.
#
# @TAG(NICTA_BSD)
#

menuconfig APP_SEL4TEST
    bool "seL4 Test"
    default y
    depends on LIB_SEL4 && (LIB_MUSL_C || LIB_SEL4_C) && LIB_SEL4_PLAT_SUPPORT && LIB_SEL4_VKA && LIB_SEL4_TEST && LIB_SEL4_UTILS && LIB_UTILS
    help
        seL4 Test application

config HAVE_TIMER
    depends on APP_SEL4TEST
    bool "Enable tests that require a timer driver"
    default n

config HAVE_CACHE
    depends on APP_SEL4TEST
    bool "Enable tests that require a functioning cache"
    default n
```

## apps/sel4test-tests/Kconfig
```kconfig
#
# Copyright 2017, Data61
# Commonwealth Scientific and Industrial Research Organisation (CSIRO)
# ABN 41 687 119 230.
#
# This software may be distributed and modified according to the terms of
# the BSD 2-Clause license. Note that NO WARRANTY is provided.
# See "LICENSE_BSD2.txt" for details.
#
# @TAG(DATA61_BSD)
#

menuconfig APP_TESTS
    bool "Tests for sel4test"
    default y
    depends on LIB_SEL4 && LIB_MUSL_C && LIB_SEL4_MUSLC_SYS && LIB_SEL4_PLAT_SUPPORT && LIB_CPIO && LIB_SEL4_ALLOCMAN && LIB_ELF && LIB_SEL4_VSPACE && LIB_SEL4_UTILS && LIB_SEL4_DEBUG && LIB_SEL4_SIMPLE_DEFAULT && LIB_SEL4_SYNC && LIB_SEL4_TESTSUPPORT && LIB_SEL4_SERIAL_SERVER
    help
        Contains all tests to be run in a separate process.
```

## libsel4testsupport/Kconfig
```kconfig
#
# Copyright 2017, Data61
# Commonwealth Scientific and Industrial Research Organisation (CSIRO)
# ABN 41 687 119 230.
#
# This software may be distributed and modified according to the terms of
# the BSD 2-Clause license. Note that NO WARRANTY is provided.
# See "LICENSE_BSD2.txt" for details.
#
# @TAG(DATA61_BSD)
#

menuconfig LIB_SEL4_TESTSUPPORT
    bool "libsel4testsupport"
    depends on HAVE_LIBC && HAVE_LIB_SEL4 && HAVE_LIB_UTILS && HAVE_LIB_SEL4_SERIAL_SERVER
    default y
    help
        Support library for sel4test apps.

config HAVE_LIB_SEL4_TESTSUPPORT
    bool
```
